AUTOSAR XML (schema 00051)
package /Components/SwcImplementations
  swc implementation sim3_Impl: programming-language=C, sw-version=1.5.1, used-code-generator=Embedded Coder 24.1 (R2024a) 19-Nov-2023, vendor-id=0, behavior=sim3_IB
    code-descriptors:
      code Code
        artifact-descriptors:
          short-label=sim3_c, category=SWSRC
          short-label=sim3_h, category=SWHDR
          short-label=sim3_private_h, category=SWHDR
          short-label=sim3_types_h, category=SWHDR
    resource consumption RsrcCons_sim3
