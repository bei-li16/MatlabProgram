AUTOSAR XML (schema 00051)
standard types defined: uint32, uint8, uint16
package /DataTypes
  impl type UFIX16_EN6: category=VALUE, base-type=uint16
package /DataTypes/ApplDataTypes
  app type UFIX16_EN6: category=VALUE, sw-calibration-access=READ-WRITE, compu {phys=raw/64}, range phys 0..1023.984375
package /DataTypes/DataTypeMappings
  data type mapping set sim3DataTypeMappingsSet: data-type-map{application-data-type=UFIX16_EN6, implementation-data-type=UFIX16_EN6}
package /DataTypes/SwAddrMethods
  sw addr method CODE: section-type=CODE
  sw addr method CONST: section-type=CONST
  sw addr method VAR: section-type=VAR
package /DataTypes/Units
  unit NoUnit: factor-si-to-unit=1, offset-si-to-unit=0
