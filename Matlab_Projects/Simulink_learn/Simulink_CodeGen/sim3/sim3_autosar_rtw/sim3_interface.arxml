AUTOSAR XML (schema 00051)
package /Interfaces
  sender receiver interface In1
    data In1: category=VALUE, sw-calibration-access=READ-ONLY, type=uint8
  sender receiver interface In2
    data In2: category=VALUE, sw-calibration-access=READ-ONLY, type=uint8
  sender receiver interface zout
    data zout: category=VALUE, sw-calibration-access=READ-ONLY, type=UFIX16_EN6
