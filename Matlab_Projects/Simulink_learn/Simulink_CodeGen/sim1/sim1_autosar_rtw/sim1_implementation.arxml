AUTOSAR XML (schema 00051)
package /Components/SwcImplementations
  swc implementation sim1_Impl: programming-language=C, sw-version=1.44.1, used-code-generator=Embedded Coder 24.1 (R2024a) 19-Nov-2023, vendor-id=0, behavior=sim1_IB
    code-descriptors:
      code Code
        artifact-descriptors:
          short-label=sim1_c, category=SWSRC
          short-label=sim1_h, category=SWHDR
          short-label=sim1_private_h, category=SWHDR
          short-label=sim1_types_h, category=SWHDR
    resource consumption RsrcCons_sim1
