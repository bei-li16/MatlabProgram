AUTOSAR XML (schema 00051)
package /Interfaces
  5 x sender receiver interface:
    In1
      data In1: category=VALUE, sw-calibration-access=READ-ONLY, type=float64
    Out1
      data Out1: category=VALUE, sw-calibration-access=READ-ONLY, type=float64
    In2
      data In2: category=VALUE, sw-calibration-access=READ-ONLY, type=float64
    In3
      data In3: category=VALUE, sw-calibration-access=READ-ONLY, type=float64
    zout
      data zout: category=VALUE, sw-calibration-access=READ-ONLY, type=float64
