AUTOSAR XML (schema 00051)
package /Interfaces
  sender receiver interface shift_sw
    data shift_sw: category=VALUE, sw-calibration-access=READ-ONLY, type=uint8
  sender receiver interface speed
    data speed: category=VALUE, sw-calibration-access=READ-ONLY, type=float32
